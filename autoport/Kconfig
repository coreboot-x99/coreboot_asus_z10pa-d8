## autoport/Kconfig
```kconfig
## SPDX-License-Identifier: GPL-2.0-only

if BOARD_ASUS_Z10PA_D8

config BOARD_SPECIFIC_OPTIONS
	def_bool y
	select BOARD_ROMSIZE_KB_16384
	select HAVE_ACPI_TABLES
	select NORTHBRIDGE_INTEL_GRANTLEY
	select SERIRQ_CONTINUOUS_MODE
	select SOUTHBRIDGE_INTEL_LYNXPOINT
	select SUPERIO_NUVOTON_COMMON_COM_A
	select SUPERIO_NUVOTON_NCT6779D

config MAINBOARD_DIR
	default "asus/z10pa-d8"

config MAINBOARD_PART_NUMBER
	default "Z10PA-D8 Series"

config USBDEBUG_HCD_INDEX # FIXME: check this
	int
	default 2
endif
```
